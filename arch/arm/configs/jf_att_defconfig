## arch/arm/configs/jf_att_defconfig
```kconfig
CONFIG_MACH_JF_ATT=y
CONFIG_EXTRA_FIRMWARE="audience-es325-fw.bin"
CONFIG_EXTRA_FIRMWARE_DIR="firmware"
CONFIG_IRDA_MC96=y
CONFIG_AUTHENTEC_VPNCLIENT_INTERCEPTOR=y
CONFIG_LOCALVERSION_AUTO=n
CONFIG_LOCALVERSION="-Jeboo_Kernel_v1.0"
```
